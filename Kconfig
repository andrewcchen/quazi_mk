## Kconfig
```kconfig
# Copyright (c) 2020 The ZMK Contributors
# SPDX-License-Identifier: MIT

mainmenu "QuaziMK Firmware"

menu "QuaziMK Configuration"

config QUAZI_BLE
	bool "BLE (HID over GATT)"
	select BT
	select BT_SMP
#	select BT_SMP_SC_PAIR_ONLY
	select BT_SMP_APP_PAIRING_ACCEPT
	select BT_PERIPHERAL
	select BT_DIS
	select BT_BAS
	select BT_SETTINGS
	select SETTINGS

if QUAZI_BLE

config SYSTEM_WORKQUEUE_STACK_SIZE
	default 2048

config ZMK_BLE_CLEAR_BONDS_ON_START
	bool "Configuration that clears all bond information from the keyboard on startup."
	default n

# HID GATT notifications sent this way are *not* picked up by Linux, and possibly others.
config BT_GATT_NOTIFY_MULTIPLE
	default n

config BT_DEVICE_APPEARANCE
	default 961

config ZMK_BLE_PASSKEY_ENTRY
	bool "Experimental: Requiring typing passkey from host to pair BLE connection"
	default n

#QUAZI_BLE
endif

module = QUAZI
module-str = QuaziMK
source "subsys/logging/Kconfig.template.log_config"

#QuaziMK Configuration
endmenu

menu "Zephyr Kernel Configuration"

source "Kconfig.zephyr"

#Zephyr Kernel Configuration
endmenu
```

## boards/arm/blu60/Kconfig.board
```kconfig
# Copyright (c) 2016 Nordic Semiconductor ASA
# SPDX-License-Identifier: Apache-2.0

config BOARD_BLU60
	bool "BLU60"
	depends on SOC_NRF52832_QFAA
```

## boards/arm/blu60/Kconfig.defconfig
```kconfig
# Copyright (c) 2016 Nordic Semiconductor ASA
# SPDX-License-Identifier: Apache-2.0

if BOARD_BLU60

config BOARD
	default "blu60"

config BT_CTLR
	default BT

endif # BOARD_BLU60
```

## boards/arm/blu60/blu60_defconfig
```kconfig
# SPDX-License-Identifier: Apache-2.0

CONFIG_SOC_SERIES_NRF52X=y
CONFIG_SOC_NRF52832_QFAA=y
CONFIG_BOARD_BLU60=y

# Enable MPU
CONFIG_ARM_MPU=y

# Enable hardware stack protection
CONFIG_HW_STACK_PROTECTION=y

# enable GPIO
CONFIG_GPIO=y

# enable uart driver
CONFIG_SERIAL=y

# enable console
CONFIG_CONSOLE=y
CONFIG_UART_CONSOLE=y

# additional board options
CONFIG_GPIO_AS_PINRESET=n

CONFIG_FLASH=y
CONFIG_SOC_FLASH_NRF_UICR=y
CONFIG_REBOOT=y
```

## boards/arm/blu64/Kconfig.defconfig
```kconfig
# Copyright (c) 2016 Nordic Semiconductor ASA
# SPDX-License-Identifier: Apache-2.0

if BOARD_BLU64

config BOARD
	default "blu64"

if USB

config USB_NRFX
	default y

config USB_DEVICE_STACK
	default y

endif # USB

config BT_CTLR
	default BT

endif # BOARD_BLU64
```
