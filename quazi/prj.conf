## CMakeLists.txt
```
target_include_directories(quazi PUBLIC
	include
)

target_sources(quazi PRIVATE
	src/ble.c
	src/hid_leds.c
	src/hog.c
	src/idle.c
	src/main.c
	src/matrix_scan.c
	src/profile.c
	src/shell.c
)

target_include_directories(glue PRIVATE
	../quantum
	include
	qmk_include
)

target_sources(glue PRIVATE
	qmk_glue/timer.c
	qmk_glue/wait.c
	qmk_glue/bootloader.c
	qmk_glue/process_bluetooth.c
	qmk_glue/matrix.c
	qmk_glue/keyboard.c
	qmk_glue/host_driver.c
	qmk_glue/led_set.c
)

target_include_directories(qmk PUBLIC
	qmk_include
)

target_sources(app PRIVATE
	main_stub.c
)
```

## prj.conf
```kconfig
CONFIG_BT_ID_MAX=4
CONFIG_BT_MAX_PAIRED=4

CONFIG_BT_FILTER_ACCEPT_LIST=y

CONFIG_BT_L2CAP_TX_BUF_COUNT=10

#CONFIG_BT_DEBUG_CONN=y
CONFIG_BT_LOG_LEVEL_INF=y

CONFIG_LOG_MODE_DEFERRED=y
CONFIG_LOG_PRINTK=y

CONFIG_BT_MAX_CONN=3
CONFIG_BT_SMP_ENFORCE_MITM=n
CONFIG_BT_DEBUG_LOG=y

CONFIG_NVS=y
CONFIG_FLASH_MAP=y
CONFIG_SETTINGS_NVS=y

CONFIG_TICKLESS_KERNEL=y
CONFIG_PM_DEVICE=y
CONFIG_PM_DEVICE_RUNTIME=y
```

## dts/bindings/quazi,matrix.yaml
```yaml
description: Keyboard matrix definition

compatible: "quazi,matrix"

properties:
  row-gpios:
    type: phandle-array
    required: true
  col-gpios:
    type: phandle-array
    required: true
  debounce-period:
    type: int
    default: 5
  diode-direction:
    type: string
    default: row2col
    enum:
      - row2col
      #- col2row
```

## src/main.c
```c
/*
 * Copyright (c) 2021 Andrew Chen <andrew@xortux.com>
 *
 * SPDX-License-Identifier: MIT
 */

#include <zephyr.h>
#include <device.h>
#include <devicetree.h>
#include <drivers/gpio.h>
#include <logging/log.h>

#include <settings/settings.h>

#include "main.h"
#include "ble.h"
#include "hid_leds.h"
#include "idle.h"
#include "matrix_scan.h"
#include "profile.h"
#include "qmk_glue.h"

#include <pm/state.h>
#include <pm/pm.h>

LOG_MODULE_REGISTER(quazi, CONFIG_QUAZI_LOG_LEVEL);

static struct k_timer main_timer;
static struct k_work main_work;

static void main_timer_handler(struct k_timer *)
{
	k_work_submit(&main_work);
}

static void quazi_main_task(struct k_work *)
{
	quazi_matrix_scan_key_down = false;

	quazi_qmk_task();

	quazi_idle_check(quazi_matrix_scan_key_down);
}

void quazi_main_loop_start(void)
{
	k_timer_start(&main_timer, K_NO_WAIT, K_MSEC(10));
}

void quazi_main_loop_stop(void)
{
	k_timer_stop(&main_timer);
}

void quazi_main(void)
{
	LOG_INF("QuaziMK Start");

	int err = settings_subsys_init();
	if (err) {
		LOG_ERR("settings_subsys_init failed (err %d)", err);
	}

	quazi_matrix_scan_init();
	quazi_hid_leds_init();

	quazi_idle_init();
	quazi_ble_init();
	quazi_profile_init();
	quazi_qmk_init();

	k_timer_init(&main_timer, main_timer_handler, NULL);
	k_work_init(&main_work, quazi_main_task);

	quazi_main_loop_start();
}
```

## include/ble.h
```c
/*
 * Copyright (c) 2021 Andrew Chen <andrew@xortux.com>
 *
 * SPDX-License-Identifier: MIT
 */

#pragma once

extern struct bt_conn *quazi_ble_conn;
extern bool quazi_ble_link_established;

void quazi_ble_init(void);

bool quazi_ble_is_active(void);

void quazi_ble_connect(int identity);
void quazi_ble_disconnect(void);
void quazi_ble_pair(int identity);
void quazi_ble_unpair(int identity);

void quazi_ble_passkey_digit(int digit);
```

## include/hid_descriptor.h
```c
#pragma once

enum hid_report_ids {
    REPORT_ID_KEYBOARD = 1,
    REPORT_ID_MOUSE,
    REPORT_ID_SYSTEM,
    REPORT_ID_CONSUMER,
    REPORT_ID_NKRO,
    REPORT_ID_JOYSTICK
};

const static uint8_t hid_report_descriptor[] = {
0x05, 0x01,        // Usage Page (Generic Desktop Ctrls)
0x09, 0x06,        // Usage (Keyboard)
0xA1, 0x01,        // Collection (Application)
0x85, REPORT_ID_KEYBOARD, // Report ID (1)
0x05, 0x07,        //   Usage Page (Kbrd/Keypad)
0x19, 0xE0,        //   Usage Minimum (0xE0)
0x29, 0xE7,        //   Usage Maximum (0xE7)
0x15, 0x00,        //   Logical Minimum (0)
0x25, 0x01,        //   Logical Maximum (1)
0x95, 0x08,        //   Report Count (8)
0x75, 0x01,        //   Report Size (1)
0x81, 0x02,        //   Input (Data,Var,Abs,No Wrap,Linear,Preferred State,No Null Position)
0x95, 0x01,        //   Report Count (1)
0x75, 0x08,        //   Report Size (8)
0x81, 0x03,        //   Input (Const,Var,Abs,No Wrap,Linear,Preferred State,No Null Position)
0x05, 0x07,        //   Usage Page (Kbrd/Keypad)
0x19, 0x00,        //   Usage Minimum (0x00)
0x29, 0xFF,        //   Usage Maximum (0xFF)
0x15, 0x00,        //   Logical Minimum (0)
0x26, 0xFF, 0x00,  //   Logical Maximum (255)
0x95, 0x06,        //   Report Count (6)
0x75, 0x08,        //   Report Size (8)
0x81, 0x00,        //   Input (Data,Array,Abs,No Wrap,Linear,Preferred State,No Null Position)
0x05, 0x08,        //   Usage Page (LEDs)
0x19, 0x01,        //   Usage Minimum (Num Lock)
0x29, 0x05,        //   Usage Maximum (Kana)
0x95, 0x05,        //   Report Count (5)
0x75, 0x01,        //   Report Size (1)
0x91, 0x02,        //   Output (Data,Var,Abs,No Wrap,Linear,Preferred State,No Null Position,Non-volatile)
0x95, 0x01,        //   Report Count (1)
0x75, 0x03,        //   Report Size (3)
0x91, 0x03,        //   Output (Const,Var,Abs,No Wrap,Linear,Preferred State,No Null Position,Non-volatile)
0xC0,              // End Collection

#ifdef EXTRAKEY_ENABLE
0x05, 0x01,        // Usage Page (Generic Desktop Ctrls)
0x09, 0x80,        // Usage (Sys Control)
0xA1, 0x01,        // Collection (Application)
0x85, REPORT_ID_SYSTEM, // Report ID (3)
0x19, 0x01,        //   Usage Minimum (Pointer)
0x2A, 0xB7, 0x00,  //   Usage Maximum (Sys Display LCD Autoscale)
0x15, 0x01,        //   Logical Minimum (1)
0x26, 0xB7, 0x00,  //   Logical Maximum (183)
0x95, 0x01,        //   Report Count (1)
0x75, 0x10,        //   Report Size (16)
0x81, 0x00,        //   Input (Data,Array,Abs,No Wrap,Linear,Preferred State,No Null Position)
0xC0,              // End Collection

0x05, 0x0C,        // Usage Page (Consumer)
0x09, 0x01,        // Usage (Consumer Control)
0xA1, 0x01,        // Collection (Application)
0x85, REPORT_ID_CONSUMER, // Report ID (4)
0x19, 0x01,        //   Usage Minimum (Consumer Control)
0x2A, 0xA0, 0x02,  //   Usage Maximum (0x02A0)
0x15, 0x01,        //   Logical Minimum (1)
0x26, 0xA0, 0x02,  //   Logical Maximum (672)
0x95, 0x01,        //   Report Count (1)
0x75, 0x10,        //   Report Size (16)
0x81, 0x00,        //   Input (Data,Array,Abs,No Wrap,Linear,Preferred State,No Null Position)
0xC0,              // End Collection
#endif
};
```

## include/hid_leds.h
```c
/*
 * Copyright (c) 2021 Andrew Chen <andrew@xortux.com>
 *
 * SPDX-License-Identifier: MIT
 */

#pragma once

void quazi_hid_leds_init(void);

void quazi_hid_leds_set(int leds);
```

## include/hog.h
```c
#pragma once

void quazi_hog_init(void);

uint8_t quazi_hog_keyboard_leds(void);

void quazi_hog_send_keyboard(uint8_t *report);

void quazi_hog_send_mouse(uint8_t *report);

void quazi_hog_send_system(uint16_t data);

void quazi_hog_send_consumer(uint16_t data);
```

## include/idle.h
```c
/*
 * Copyright (c) 2022 Andrew Chen <andrew@xortux.com>
 *
 * SPDX-License-Identifier: MIT
 */

enum idle_level {
	IDLE_NONE,
	IDLE_MATRIX,
	IDLE_DISCONN,
	IDLE_SLEEP,
};

void quazi_idle_enter(enum idle_level level);

void quazi_idle_check(bool key_down);

void quazi_idle_leave(void);

void quazi_idle_init(void);
```

## include/matrix_scan.h
```c
#pragma once

void quazi_matrix_scan_init(void);

uint32_t quazi_matrix_scan_row(int row);

extern bool quazi_matrix_scan_key_down;

void quazi_matrix_scan_enter_idle(void);
void quazi_matrix_scan_leave_idle(void);
```

## include/profile.h
```c
/*
 * Copyright (c) 2021 Andrew Chen <andrew@xortux.com>
 *
 * SPDX-License-Identifier: MIT
 */

#pragma once

void quazi_profile_init(void);

void quazi_profile_select(int profile);
int quazi_profile_selected(void);

void quazi_profile_connect(void);
void quazi_profile_disconnect(void);
void quazi_profile_pair(void);
void quazi_profile_clear(void);

void quazi_profile_enter_idle(void);
void quazi_profile_leave_idle(void);

void quazi_profile_task(bool key_down);
```

## include/qmk_glue.h
```c
#pragma once

void quazi_qmk_init(void);

void quazi_qmk_task(void);

void quazi_qmk_host_driver_init(void);
```

## include/quazi.h
```c
#pragma once

void quazi_main(void);

void quazi_main_loop_start(void);

void quazi_main_loop_stop(void);
```

## src/ble.c
```c
/*
 * Copyright (c) 2021 Andrew Chen <andrew@xortux.com>
 *
 * SPDX-License-Identifier: MIT
 *
 * Copyright (c) 2016 Intel Corporation
 *
 * SPDX-License-Identifier: Apache-2.0
 */

#include <zephyr/types.h>
#include <stddef.h>
#include <string.h>
#include <errno.h>
#include <sys/printk.h>
#include <sys/byteorder.h>
#include <zephyr.h>

#include <settings/settings.h>

#include <bluetooth/bluetooth.h>
#include <bluetooth/hci.h>
#include <bluetooth/conn.h>
#include <bluetooth/uuid.h>
#include <bluetooth/gatt.h>
#include <bluetooth/gap.h>

#include <logging/log.h>

#include "hog.h"
#include "idle.h"
#include "profile.h"

LOG_MODULE_DECLARE(quazi, CONFIG_QUAZI_LOG_LEVEL);

/// Handle for current connection, NULL if disconnected
struct bt_conn *quazi_ble_conn;
// An encrypted link has been established, ready to send notifications to
bool quazi_ble_link_established;

static int8_t connect_id, unpair_id, pair_id;
static bool advertising_active;

static int8_t passkey_digits_left;
static int passkey_entered;

static struct k_work_delayable stop_adv_work;
static struct k_work start_directed_adv_work;
static struct k_work start_pairing_adv_work;
static struct k_work disconnect_work;
static struct k_work unpair_work;


static void do_adv_stop(void) {
	advertising_active = false;

	int err = bt_le_adv_stop();
	if (err) {
		LOG_ERR("Failed to stop advertising (err %d)", err);
	}
}

static void connected(struct bt_conn *conn, uint8_t err)
{
	int rc;

	do_adv_stop();

	k_work_cancel_delayable(&stop_adv_work);

	char addr[BT_ADDR_LE_STR_LEN];
	bt_addr_le_to_str(bt_conn_get_dst(conn), addr, sizeof(addr));

	if (err) {
		LOG_ERR("Failed to connect to %s (%u)", log_strdup(addr), err);
		quazi_idle_enter(IDLE_DISCONN);
		return;
	}

	bt_conn_ref(conn);
	quazi_ble_conn = conn;

	rc = bt_conn_set_security(conn, BT_SECURITY_L4);
	if (rc) {
		LOG_ERR("Failed to set security (err %d)", rc);
	}

	// TODO update connection parameters

	LOG_INF("Connected %s", log_strdup(addr));
}

static void disconnected(struct bt_conn *conn, uint8_t reason)
{
	char addr[BT_ADDR_LE_STR_LEN];

	bt_addr_le_to_str(bt_conn_get_dst(conn), addr, sizeof(addr));

	LOG_INF("Disconnected from %s (reason 0x%02x)", log_strdup(addr), reason);

	if (quazi_ble_conn != conn)
		return;

	bt_conn_unref(conn);
	quazi_ble_conn = NULL;
	quazi_ble_link_established = false;

	if (reason == BT_HCI_ERR_CONN_TIMEOUT) {
		k_work_submit(&start_directed_adv_work);
	} else {
		quazi_idle_enter(IDLE_DISCONN);
	}
}

static void security_changed(struct bt_conn *conn, bt_security_t level, enum bt_security_err err)
{
	char addr[BT_ADDR_LE_STR_LEN];

	bt_addr_le_to_str(bt_conn_get_dst(conn), addr, sizeof(addr));

	if (!err) {
		LOG_INF("Security changed: %s level %u", log_strdup(addr), level);
		quazi_ble_link_established = true;
	} else {
		LOG_ERR("Security failed: %s level %u (err %d)", log_strdup(addr), level, err);
		bt_conn_disconnect(conn, BT_HCI_ERR_AUTH_FAIL);
	}
}

static struct bt_conn_cb conn_callbacks = {
	.connected = connected,
	.disconnected = disconnected,
	.security_changed = security_changed,
};

static void auth_passkey_entry(struct bt_conn *conn)
{
	char addr[BT_ADDR_LE_STR_LEN];
	bt_addr_le_to_str(bt_conn_get_dst(conn), addr, sizeof(addr));
	LOG_INF("Passkey entry for %s", log_strdup(addr));

	passkey_entered = 0;
	passkey_digits_left = 6;
}

static void auth_cancel(struct bt_conn *conn)
{
	LOG_INF("Pairing cancelled");
}

static void unpair_other(const struct bt_bond_info *info, void *data) {
	bt_addr_le_t *addr = data;
	if (bt_addr_le_cmp(addr, &info->addr)) {
		int err = bt_unpair(unpair_id, &info->addr);
		if (err) {
			char addr_str[BT_ADDR_LE_STR_LEN];
			bt_addr_le_to_str(&info->addr, addr_str, sizeof(addr_str));
			LOG_WRN("Failed to unpair %s (err %d)", log_strdup(addr_str), err);
		}
	}
}

static void pairing_complete(struct bt_conn *conn, bool bonded)
{
	LOG_INF("Pairing Complete (bonded %d)", bonded);

	struct bt_conn_info info;
	bt_conn_get_info(conn, &info);
	bt_foreach_bond(info.id, unpair_other, (void *)bt_conn_get_dst(conn));
}

static void pairing_failed(struct bt_conn *conn, enum bt_security_err reason)
{
	LOG_INF("Pairing Failed (%d)", reason);
	bt_conn_disconnect(conn, BT_HCI_ERR_AUTH_FAIL);
}

static struct bt_conn_auth_cb auth_cb_display = {
	.passkey_entry = auth_passkey_entry,
	.cancel = auth_cancel,
	.pairing_complete = pairing_complete,
	.pairing_failed = pairing_failed,
};

/** Advertising data */
static const struct bt_data ad_data[] = {
	BT_DATA_BYTES(BT_DATA_FLAGS, (BT_LE_AD_GENERAL | BT_LE_AD_NO_BREDR)),
	BT_DATA_BYTES(BT_DATA_UUID16_ALL, BT_UUID_16_ENCODE(BT_UUID_HIDS_VAL))
};

/** Stop advertising
 */
static void stop_adv(struct k_work *)
{
	do_adv_stop();

	LOG_INF("Stopped advertising");
}

static void get_bonded_addr_helper(const struct bt_bond_info *info, void *data)
{
	bt_addr_le_t *addr = data;
	if (bt_addr_le_cmp(addr, BT_ADDR_LE_NONE)) {
		LOG_WRN("Multiple bonds stored for id %d", connect_id);
	}
	bt_addr_le_copy(addr, &info->addr);
}

/** Start fast directed advertising to connect to bonded host
 */
static void start_directed_adv(struct k_work *)
{
	if (quazi_ble_conn != NULL) {
		bt_conn_unref(quazi_ble_conn);
		quazi_ble_conn = NULL;
		quazi_ble_link_established = false;
	}

	bt_addr_le_t _addr, *addr = &_addr;
	bt_addr_le_copy(addr, BT_ADDR_LE_NONE);

	bt_foreach_bond(connect_id, get_bonded_addr_helper, addr);
	if (!bt_addr_le_cmp(addr, BT_ADDR_LE_NONE)) {
		LOG_ERR("No bonds stored for id %d", connect_id);
		return;
	}

	struct bt_le_adv_param adv_param = BT_LE_ADV_PARAM_INIT(
			BT_LE_ADV_OPT_CONNECTABLE | BT_LE_ADV_OPT_ONE_TIME | BT_LE_ADV_OPT_DIR_ADDR_RPA,
			0, 0, addr);
	adv_param.id = connect_id;

	if (IS_ENABLED(CONFIG_BT_FILTER_filter_accept_LIST)) {
		bt_le_filter_accept_list_clear();
		bt_le_filter_accept_list_add(addr);
	}

	int err = bt_le_adv_start(&adv_param, ad_data, ARRAY_SIZE(ad_data), NULL, 0);
	if (err) {
		LOG_ERR("Failed to start directed advertising (err %d)", err);
		return;
	}

	advertising_active = true;

	LOG_INF("Started directed advertising");
}

/** Start fast undirected advertising to connect to non-bonded host
 *
 * 180s advertising duration, 20ms to 30ms advertising interval
 */
static void start_pairing_adv(struct k_work *)
{
	if (quazi_ble_conn != NULL) {
		bt_conn_unref(quazi_ble_conn);
		quazi_ble_conn = NULL;
		quazi_ble_link_established = false;
	}

	struct bt_le_adv_param adv_param = BT_LE_ADV_PARAM_INIT(
			BT_LE_ADV_OPT_CONNECTABLE | BT_LE_ADV_OPT_ONE_TIME | BT_LE_ADV_OPT_USE_NAME,
			0x20, 0x30, NULL);
	adv_param.id = pair_id;

	if (IS_ENABLED(CONFIG_BT_FILTER_filter_accept_LIST)) {
		bt_le_filter_accept_list_clear();
	}

	int err = bt_le_adv_start(&adv_param, ad_data, ARRAY_SIZE(ad_data), NULL, 0);
	if (err) {
		LOG_ERR("Failed to start pairing advertising (err %d)", err);
		return;
	}

	k_work_schedule(&stop_adv_work, K_SECONDS(180));

	advertising_active = true;

	LOG_INF("Started pairing advertising");
}

static void disconnect_conn(struct bt_conn *conn, void *)
{
	bt_conn_ref(conn);

	const bt_addr_le_t *addr = bt_conn_get_dst(conn);
	if (bt_addr_le_cmp(addr, BT_ADDR_LE_NONE)) {

		int err = bt_conn_disconnect(conn, BT_HCI_ERR_REMOTE_USER_TERM_CONN);
		if (err) {
			char addr_str[BT_ADDR_LE_STR_LEN];
			bt_addr_le_to_str(addr, addr_str, sizeof(addr_str));
			LOG_WRN("Failed to disconnect from %s (err %d)", log_strdup(addr_str), err);
		}
	}

	bt_conn_unref(conn);
}

static void disconnect(struct k_work *work)
{
	do_adv_stop();

	bt_conn_foreach(BT_CONN_TYPE_ALL, disconnect_conn, NULL);
}

static void unpair(struct k_work *work)
{
	int err = bt_unpair(unpair_id, NULL);
	if (err) {
		LOG_WRN("Failed to unpair for id %d (err %d)", unpair_id, err);
	}
}


void quazi_ble_connect(int identity)
{
	// check if already connected to same identity
	if (quazi_ble_conn == NULL || identity != connect_id) {

		connect_id = identity;

		if (!k_work_is_pending(&start_directed_adv_work)) {
			k_work_submit(&disconnect_work);
			k_work_submit(&start_directed_adv_work);
		}
	}
}

void quazi_ble_disconnect(void)
{
	k_work_submit(&disconnect_work);
}

void quazi_ble_pair(int identity)
{
	pair_id = identity;

	if (!k_work_is_pending(&start_pairing_adv_work)) {
		k_work_submit(&disconnect_work);
		k_work_submit(&start_pairing_adv_work);
	}
}

void quazi_ble_unpair(int identity)
{
	unpair_id = identity;

	if (!k_work_is_pending(&unpair_work)) {
		k_work_submit(&disconnect_work);
		k_work_submit(&unpair_work);
	}
}

void quazi_ble_passkey_digit(int digit)
{
	if (quazi_ble_conn && passkey_digits_left > 0) {
		passkey_digits_left--;
		passkey_entered = passkey_entered * 10 + digit;

		if (passkey_digits_left == 0) {
			LOG_INF("Passkey: %06d", passkey_entered);
			bt_conn_auth_passkey_entry(quazi_ble_conn, passkey_entered);
			passkey_entered = 0;
		}
	}
}

bool quazi_ble_is_active(void) {
	return quazi_ble_conn != NULL || advertising_active;
}

void quazi_ble_init(void)
{
	k_work_init_delayable(&stop_adv_work, stop_adv);
	k_work_init(&start_directed_adv_work, start_directed_adv);
	k_work_init(&start_pairing_adv_work, start_pairing_adv);
	k_work_init(&disconnect_work, disconnect);
	k_work_init(&unpair_work, unpair);

	advertising_active = false;

	int err = bt_enable(NULL);
	if (err) {
		LOG_ERR("Bluetooth init failed (err %d)", err);
		return;
	}

	err = settings_load_subtree("bt");
	if (err) {
		LOG_ERR("Failed to load bluetooth settings (err %d)", err);
		return;
	}

	quazi_hog_init();

	bt_conn_cb_register(&conn_callbacks);
	bt_conn_auth_cb_register(&auth_cb_display);

	LOG_INF("Bluetooth initialized");
}
```

## src/hid_leds.c
```c
/*
 * Copyright (c) 2021 Andrew Chen <andrew@xortux.com>
 *
 * SPDX-License-Identifier: MIT
 */

#include <zephyr.h>
#include <device.h>
#include <devicetree.h>
#include <drivers/gpio.h>
#include <logging/log.h>

#include "hid_leds.h"

#define HAS_NUM DT_HAS_CHOSEN(quazi_num_lock_led)
#define NUM_NODE DT_CHOSEN(quazi_num_lock_led)

#define HAS_CAPS DT_HAS_CHOSEN(quazi_caps_lock_led)
#define CAPS_NODE DT_CHOSEN(quazi_caps_lock_led)

#define HAS_SCROLL DT_HAS_CHOSEN(quazi_scroll_lock_led)
#define SCROLL_NODE DT_CHOSEN(quazi_scroll_lock_led)

#if HAS_NUM
static const struct device *num_dev;
static int num_pin;
#endif
#if HAS_CAPS
static const struct device *caps_dev;
static int caps_pin;
#endif
#if HAS_SCROLL
static const struct device *scroll_dev;
static int scroll_pin;
#endif

LOG_MODULE_DECLARE(quazi, CONFIG_QUAZI_LOG_LEVEL);

void quazi_hid_leds_init(void) {

#if HAS_NUM
	num_dev = device_get_binding(DT_GPIO_LABEL(NUM_NODE, gpios));
	num_pin = DT_GPIO_PIN(NUM_NODE, gpios);
	gpio_pin_configure(num_dev, num_pin,
			DT_GPIO_FLAGS(NUM_NODE, gpios) | GPIO_OUTPUT_INACTIVE);
#endif

#if HAS_CAPS
	caps_dev = device_get_binding(DT_GPIO_LABEL(CAPS_NODE, gpios));
	caps_pin = DT_GPIO_PIN(CAPS_NODE, gpios);
	gpio_pin_configure(caps_dev, caps_pin,
			DT_GPIO_FLAGS(CAPS_NODE, gpios) | GPIO_OUTPUT_INACTIVE);
#endif

#if HAS_SCROLL
	scroll_dev = device_get_binding(DT_GPIO_LABEL(SCROLL_NODE, gpios));
	scroll_pin = DT_GPIO_PIN(SCROLL_NODE, gpios);
	gpio_pin_configure(scroll_dev, scroll_pin,
			DT_GPIO_FLAGS(SCROLL_NODE, gpios) | GPIO_OUTPUT_INACTIVE);
#endif

}

void quazi_hid_leds_set(int leds) {
	/* HID keyboard output report:
	 * 0 NUM LOCK
	 * 1 CAPS LOCK
	 * 2 SCROLL LOCK
	 * 3 COMPOSE
	 * 4 KANA
	 */
#if HAS_NUM
	gpio_pin_set(num_dev, num_pin, leds & 1);
#endif
#if HAS_CAPS
	gpio_pin_set(caps_dev, caps_pin, leds & 2);
#endif
#if HAS_SCROLL
	gpio_pin_set(scroll_dev, scroll_pin, leds & 4);
#endif
}
```

## src/hog.c
```c
/*
 * Copyright (c) 2021 Andrew Chen <andrew@xortux.com>
 *
 * SPDX-License-Identifier: MIT
 *
 * Copyright (c) 2016 Intel Corporation
 *
 * SPDX-License-Identifier: Apache-2.0
 */

#include <zephyr/types.h>
#include <stddef.h>
#include <string.h>
#include <errno.h>
#include <sys/printk.h>
#include <sys/byteorder.h>
#include <zephyr.h>
#include <logging/log.h>

#include <bluetooth/bluetooth.h>
#include <bluetooth/hci.h>
#include <bluetooth/conn.h>
#include <bluetooth/uuid.h>
#include <bluetooth/gatt.h>

#include "ble.h"
#include "hog.h"
#include "hid_descriptor.h"

LOG_MODULE_DECLARE(quazi, CONFIG_QUAZI_LOG_LEVEL);

enum {
	HIDS_REMOTE_WAKE = BIT(0),
	HIDS_NORMALLY_CONNECTABLE = BIT(1),
};

// HID Information
struct hids_info {
	uint16_t bcdHID;
	uint8_t bcountryCode;
	uint8_t flags;
} __packed;

enum {
	HIDS_INPUT = 0x01,
	HIDS_OUTPUT = 0x02,
	HIDS_FEATURE = 0x03,
};

// Report characteristic descriptor
struct report_chrc_desc {
	uint8_t id;
	uint8_t type;
} __packed;

static struct hids_info hid_info = {
	.bcdHID = 0x0112,
	.bcountryCode = 0x00,
	.flags = HIDS_NORMALLY_CONNECTABLE,
};

static struct report_chrc_desc keyboard_chrc_desc = {
	.id = REPORT_ID_KEYBOARD,
	.type = HIDS_INPUT,
};

static struct report_chrc_desc led_chrc_desc = {
	.id = REPORT_ID_KEYBOARD,
	.type = HIDS_OUTPUT,
};

#ifdef MOUSEKEY_ENABLE
static struct report_chrc_desc mouse_chrc_desc = {
	.id = REPORT_ID_MOUSE,
	.type = HIDS_INPUT,
};
#endif

#ifdef EXTRAKEY_ENABLE
static struct report_chrc_desc system_chrc_desc = {
	.id = REPORT_ID_SYSTEM,
	.type = HIDS_INPUT,
};

static struct report_chrc_desc consumer_chrc_desc = {
	.id = REPORT_ID_CONSUMER,
	.type = HIDS_INPUT,
};
#endif

static uint8_t keyboard_report[8];
static uint8_t led_report;

static ssize_t read_hid_info(struct bt_conn *conn,
		const struct bt_gatt_attr *attr, void *buf,
		uint16_t len, uint16_t offset)
{
	return bt_gatt_attr_read(conn, attr, buf, len, offset,
			&hid_info, sizeof(hid_info));
}

static ssize_t read_report_map(struct bt_conn *conn,
		const struct bt_gatt_attr *attr, void *buf,
		uint16_t len, uint16_t offset)
{
	return bt_gatt_attr_read(conn, attr, buf, len, offset,
			hid_report_descriptor, sizeof(hid_report_descriptor));
}

static ssize_t read_report_chrc_desc(struct bt_conn *conn,
		const struct bt_gatt_attr *attr, void *buf,
		uint16_t len, uint16_t offset)
{
	return bt_gatt_attr_read(conn, attr, buf, len, offset,
			attr->user_data, sizeof(struct report_chrc_desc));
}

static ssize_t read_keyboard_report(struct bt_conn *conn,
		const struct bt_gatt_attr *attr, void *buf,
		uint16_t len, uint16_t offset)
{
	return bt_gatt_attr_read(conn, attr, buf, len, offset,
			keyboard_report, sizeof(keyboard_report));
}


static ssize_t write_led_report(struct bt_conn *conn,
		const struct bt_gatt_attr *attr, const void *buf,
		uint16_t len, uint16_t offset, uint8_t flags)
{
	if (len != 1) {
		LOG_WRN("Invalid led report received: len = %d", len);
	}

	led_report = ((uint8_t *)buf)[0];

	return len;
}

static ssize_t write_ctrl_point(struct bt_conn *conn,
		const struct bt_gatt_attr *attr,
		const void *buf, uint16_t len, uint16_t offset,
		uint8_t flags)
{
	LOG_HEXDUMP_DBG(buf, len, "write_ctrl_point");

	return len;
}

// Token variables whose address we put in the user_data field of the report
// characteristic attribute structs. Then init can iterate over all the
// attributes and find the report characterstics
static char keyboard_attr_token;
#ifdef MOUSEKEY_ENABLE
static char mouse_attr_token;
#endif
#ifdef EXTRAKEY_ENABLE
static char system_attr_token;
static char consumer_attr_token;
#endif

/* HID Service Declaration */
BT_GATT_SERVICE_DEFINE(hog_svc,
	BT_GATT_PRIMARY_SERVICE(BT_UUID_HIDS),

	BT_GATT_CHARACTERISTIC(BT_UUID_HIDS_INFO, BT_GATT_CHRC_READ,
			BT_GATT_PERM_READ, read_hid_info, NULL, NULL),

	BT_GATT_CHARACTERISTIC(BT_UUID_HIDS_REPORT_MAP, BT_GATT_CHRC_READ,
			BT_GATT_PERM_READ, read_report_map, NULL, NULL),

	BT_GATT_CHARACTERISTIC(BT_UUID_HIDS_REPORT,
			BT_GATT_CHRC_READ | BT_GATT_CHRC_NOTIFY,
			BT_GATT_PERM_READ_ENCRYPT,
			read_keyboard_report, NULL, &keyboard_attr_token),
	BT_GATT_CCC(NULL, BT_GATT_PERM_READ | BT_GATT_PERM_WRITE),
	BT_GATT_DESCRIPTOR(BT_UUID_HIDS_REPORT_REF, BT_GATT_PERM_READ,
			read_report_chrc_desc, NULL, &keyboard_chrc_desc),

	BT_GATT_CHARACTERISTIC(BT_UUID_HIDS_REPORT,
			BT_GATT_CHRC_WRITE,
			BT_GATT_PERM_WRITE_ENCRYPT,
			NULL, write_led_report, NULL),
	BT_GATT_CCC(NULL, BT_GATT_PERM_READ | BT_GATT_PERM_WRITE),
	BT_GATT_DESCRIPTOR(BT_UUID_HIDS_REPORT_REF, BT_GATT_PERM_READ,
			read_report_chrc_desc, NULL, &led_chrc_desc),

#ifdef EXTRAKEY_ENABLE
	BT_GATT_CHARACTERISTIC(BT_UUID_HIDS_REPORT,
			BT_GATT_CHRC_NOTIFY,
			BT_GATT_PERM_NONE,
			NULL, NULL, &system_attr_token),
	BT_GATT_CCC(NULL, BT_GATT_PERM_READ | BT_GATT_PERM_WRITE),
	BT_GATT_DESCRIPTOR(BT_UUID_HIDS_REPORT_REF, BT_GATT_PERM_READ,
			read_report_chrc_desc, NULL, &system_chrc_desc),

	BT_GATT_CHARACTERISTIC(BT_UUID_HIDS_REPORT,
			BT_GATT_CHRC_NOTIFY,
			BT_GATT_PERM_NONE,
			NULL, NULL, &consumer_attr_token),
	BT_GATT_CCC(NULL, BT_GATT_PERM_READ | BT_GATT_PERM_WRITE),
	BT_GATT_DESCRIPTOR(BT_UUID_HIDS_REPORT_REF, BT_GATT_PERM_READ,
			read_report_chrc_desc, NULL, &consumer_chrc_desc),
#endif

	BT_GATT_CHARACTERISTIC(BT_UUID_HIDS_CTRL_POINT,
			BT_GATT_CHRC_WRITE_WITHOUT_RESP,
			BT_GATT_PERM_WRITE,
			NULL, write_ctrl_point, NULL),
);

static const struct bt_gatt_attr *keyboard_attr;
#ifdef MOUSEKEY_ENABLE
static const struct bt_gatt_attr *mouse_attr;
#endif
#ifdef EXTRAKEY_ENABLE
static const struct bt_gatt_attr *system_attr;
static const struct bt_gatt_attr *consumer_attr;
#endif

uint8_t quazi_hog_keyboard_leds(void)
{
	return led_report;
}

void quazi_hog_send_keyboard(uint8_t *report)
{
	memcpy(keyboard_report, report, sizeof(keyboard_report));
	if (quazi_ble_link_established) {
		int err = bt_gatt_notify(quazi_ble_conn, keyboard_attr, report, 8);
		if (err) {
			LOG_WRN("bt_gatt_notify failed (%d)", err);
		}
	}
}

void quazi_hog_send_mouse(uint8_t *report)
{
#ifdef MOUSEKEY_ENABLE
#endif
}

void quazi_hog_send_system(uint16_t data)
{
#ifdef EXTRAKEY_ENABLE
	if (quazi_ble_link_established) {
		int err = bt_gatt_notify(quazi_ble_conn, system_attr, &data, 2);
		if (err) {
			LOG_WRN("bt_gatt_notify failed (%d)", err);
		}
	}
#endif
}

void quazi_hog_send_consumer(uint16_t data)
{
#ifdef EXTRAKEY_ENABLE
	if (quazi_ble_link_established) {
		int err = bt_gatt_notify(quazi_ble_conn, consumer_attr, &data, 2);
		if (err) {
			LOG_WRN("bt_gatt_notify failed (%d)", err);
		}
	}
#endif
}

void quazi_hog_init(void)
{
	for (int i = 0; i < ARRAY_SIZE(attr_hog_svc); i++) {

		if (attr_hog_svc[i].user_data == &keyboard_attr_token)
			keyboard_attr = &attr_hog_svc[i];

#ifdef MOUSEKEY_ENABLE
		if (attr_hog_svc[i].user_data == &mouse_attr_token)
			mouse_attr = &attr_hog_svc[i];
#endif

#ifdef EXTRAKEY_ENABLE
		if (attr_hog_svc[i].user_data == &system_attr_token)
			system_attr = &attr_hog_svc[i];

		if (attr_hog_svc[i].user_data == &consumer_attr_token)
			consumer_attr = &attr_hog_svc[i];
#endif
	}
}
```
